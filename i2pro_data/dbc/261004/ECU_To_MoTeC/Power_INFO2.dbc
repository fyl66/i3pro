VERSION ""

NS_ :

BS_:

BU_:

BO_ 196 Power_INFO2: 8 Vector__XXX
 SG_ LV : 0|16@1- (0.01,0) [-327.68|327.67] "V" Vector__XXX
 SG_ Battery_Power : 16|16@1- (0.01,0) [-327.68|327.67] "kW" Vector__XXX

BA_DEF_  "BusType" STRING ;
BA_DEF_DEF_  "BusType" "CAN";
