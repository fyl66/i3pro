VERSION ""

NS_ :

BS_:

BU_:

BO_ 194 Rod_INFO: 8 Vector__XXX
 SG_ RodForce2 : 16|16@1- (0.01,0) [-327.68|327.67] "kg" Vector__XXX
 SG_ RodForce1 : 0|16@1- (0.01,0) [-327.68|327.67] "kg" Vector__XXX

BA_DEF_  "BusType" STRING ;
BA_DEF_DEF_  "BusType" "CAN";
