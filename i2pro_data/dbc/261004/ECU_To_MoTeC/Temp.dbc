VERSION ""

NS_ :

BS_:

BU_:

BO_ 198 Temp_INFO: 8 Vector__XXX
 SG_ InverterTempMax : 16|16@1+ (0.01,0) [0|655.35] "C" Vector__XXX
 SG_ MotorTempMax : 0|16@1+ (0.01,0) [0|655.35] "C" Vector__XXX

BA_DEF_  "BusType" STRING ;
BA_DEF_DEF_  "BusType" "CAN";
