VERSION ""

NS_ :

BS_:

BU_:

BO_ 201 DriverGear_INFO: 8 Vector__XXX
 SG_ Aceinna_Yaw_Angular_Rate : 3|13@1- (1,0) [-4096|4095] "" Vector__XXX
 SG_ SOC_flag6 : 57|1@1+ (1,0) [0|1] "" Vector__XXX
 SG_ SOC_flag21 : 60|1@1+ (1,0) [0|1] "" Vector__XXX
 SG_ SOC_flag16 : 59|1@1+ (1,0) [0|1] "" Vector__XXX
 SG_ SOC_flag11 : 58|1@1+ (1,0) [0|1] "" Vector__XXX
 SG_ SOC_flag1 : 56|1@1+ (1,0) [0|1] "" Vector__XXX
 SG_ SOC_flag46 : 52|1@1+ (1,0) [0|1] "" Vector__XXX
 SG_ SOC_flag41 : 51|1@1+ (1,0) [0|1] "" Vector__XXX
 SG_ SOC_flag36 : 50|1@1+ (1,0) [0|1] "" Vector__XXX
 SG_ SOC_flag31 : 49|1@1+ (1,0) [0|1] "" Vector__XXX
 SG_ SOC_flag26 : 48|1@1+ (1,0) [0|1] "" Vector__XXX
 SG_ SOC_flag71 : 44|1@1+ (1,0) [0|1] "" Vector__XXX
 SG_ SOC_flag66 : 43|1@1+ (1,0) [0|1] "" Vector__XXX
 SG_ SOC_flag61 : 42|1@1+ (1,0) [0|1] "" Vector__XXX
 SG_ SOC_flag56 : 41|1@1+ (1,0) [0|1] "" Vector__XXX
 SG_ SOC_flag51 : 40|1@1+ (1,0) [0|1] "" Vector__XXX
 SG_ SOC_flag96 : 36|1@1+ (1,0) [0|1] "" Vector__XXX
 SG_ SOC_flag91 : 35|1@1+ (1,0) [0|1] "" Vector__XXX
 SG_ SOC_flag86 : 34|1@1+ (1,0) [0|1] "" Vector__XXX
 SG_ SOC_flag81 : 33|1@1+ (1,0) [0|1] "" Vector__XXX
 SG_ SOC_flag76 : 32|1@1+ (1,0) [0|1] "" Vector__XXX
 SG_ SW_Angle : 16|16@1- (0.01,0) [-327.68|327.67] "deg" Vector__XXX
 SG_ DriverGear : 0|3@1+ (1,0) [0|65535] "" Vector__XXX

BA_DEF_  "BusType" STRING ;
BA_DEF_DEF_  "BusType" "CAN";
